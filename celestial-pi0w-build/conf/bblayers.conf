## celestial-pi0w-build/conf/bblayers.conf
```bitbake
# POKY_BBLAYERS_CONF_VERSION is increased each time build/conf/bblayers.conf
# changes incompatibly
POKY_BBLAYERS_CONF_VERSION = "2"

BBPATH = "${TOPDIR}"
BBFILES ?= ""

BBLAYERS ?= " \
  ../sources/poky/meta \
  ../sources/poky/meta-poky \
  ../sources/poky/meta-yocto-bsp \
  ../sources/meta-raspberrypi \
  ../sources/meta-pseudodesign \
  ../sources/meta-celestial \
  ../sources/meta-virtualization \
  ../sources/meta-openembedded/meta-filesystems \
  ../sources/meta-openembedded/meta-python \
  ../sources/meta-openembedded/meta-networking \
  ../sources/meta-openembedded/meta-oe \
  ../sources/meta-dbox \  
  "
```

## celestial-pi3-build/conf/bblayers.conf
```bitbake
# POKY_BBLAYERS_CONF_VERSION is increased each time build/conf/bblayers.conf
# changes incompatibly
POKY_BBLAYERS_CONF_VERSION = "2"

BBPATH = "${TOPDIR}"
BBFILES ?= ""

BBLAYERS ?= " \
  /app/oe/sources/poky/meta \
  /app/oe/sources/poky/meta-poky \
  /app/oe/sources/poky/meta-yocto-bsp \
  /app/oe/sources/meta-raspberrypi \
  /app/oe/sources/meta-pseudodesign \
  /app/oe/sources/meta-virtualization \
  /app/oe/sources/meta-openembedded/meta-filesystems \
  /app/oe/sources/meta-openembedded/meta-python \
  /app/oe/sources/meta-openembedded/meta-networking \
  /app/oe/sources/meta-openembedded/meta-oe \
  "
```

## toradex-nxp-build/conf/bblayers.conf
```bitbake
# POKY_BBLAYERS_CONF_VERSION is increased each time build/conf/bblayers.conf
# changes incompatibly
POKY_BBLAYERS_CONF_VERSION = "2"

BBPATH = "${TOPDIR}"
BBFILES ?= ""

BBLAYERS ?= " \
  /app/oe/sources/poky/meta \
  /app/oe/sources/poky/meta-poky \
  /app/oe/sources/poky/meta-yocto-bsp \
  /app/oe/sources/meta-freescale \
  /app/oe/sources/meta-freescale-3rdparty \
  /app/oe/sources/meta-pseudodesign \
  /app/oe/sources/meta-toradex-bsp-common \
  /app/oe/sources/meta-toradex-demos \
  /app/oe/sources/meta-toradex-nxp \
  "
```
